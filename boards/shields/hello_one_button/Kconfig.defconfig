## boards/shields/hello_one_button/Kconfig.defconfig
```kconfig
if SHIELD_HELLO_ONE_BUTTON

config ZMK_KEYBOARD_NAME
    default "hello_one_button"

endif # SHIELD_HELLO_ONE_BUTTON
```

## boards/shields/hello_one_button/Kconfig.shield
```kconfig
config SHIELD_HELLO_ONE_BUTTON
    def_bool $(shields_list_contains,hello_one_button)
```

## boards/shields/jwkbd_v1/Kconfig.defconfig
```kconfig
if SHIELD_JWKBD_V1_LEFT

config ZMK_KEYBOARD_NAME
    default "jwkbd_v1"

config ZMK_SPLIT_ROLE_CENTRAL
    default y

endif # SHIELD_JWKBD_V1_LEFT

if SHIELD_JWKBD_V1_LEFT || SHIELD_JWKBD_V1_RIGHT

config ZMK_SPLIT
    default y

endif # SHIELD_JWKBD_V1_LEFT || SHIELD_JWKBD_V1_RIGHT
```

## boards/shields/jwkbd_v1/Kconfig.shield
```kconfig
config SHIELD_JWKBD_V1_LEFT
    def_bool $(shields_list_contains,jwkbd_v1_left)

config SHIELD_JWKBD_V1_RIGHT
    def_bool $(shields_list_contains,jwkbd_v1_right)
```

## boards/shields/jwkbd_v2/Kconfig.defconfig
```kconfig
if SHIELD_JWKBD_V2_LEFT

config ZMK_KEYBOARD_NAME
    default "jwkbd_v2"

config ZMK_SPLIT_ROLE_CENTRAL
    default y

endif # SHIELD_JWKBD_V2_LEFT

if SHIELD_JWKBD_V2_LEFT || SHIELD_JWKBD_V2_RIGHT

config ZMK_SPLIT
    default y

endif # SHIELD_JWKBD_V2_LEFT || SHIELD_JWKBD_V2_RIGHT
```

## boards/shields/jwkbd_v2/Kconfig.shield
```kconfig
config SHIELD_JWKBD_V2_LEFT
    def_bool $(shields_list_contains,jwkbd_v2_left)

config SHIELD_JWKBD_V2_RIGHT
    def_bool $(shields_list_contains,jwkbd_v2_right)
```
